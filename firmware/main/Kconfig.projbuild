## firmware/main/Kconfig.projbuild
```kconfig
menu "Speccy bench firmware"
    config SPECCY_SPI_CLOCK_MHZ
        int "GC9107 SPI clock (MHz)"
        range 1 40
        default 20
        help
            Start at 20 MHz. Change only after checking the selected LCD and
            wiring. Lower clocks can prevent the 25 fps target being met.
endmenu
```

## firmware/sdkconfig.defaults
```kconfig
CONFIG_IDF_TARGET="esp32"
CONFIG_ESPTOOLPY_FLASHSIZE_4MB=y
CONFIG_ESP_DEFAULT_CPU_FREQ_MHZ_240=y
CONFIG_FREERTOS_HZ=1000
CONFIG_ESP_MAIN_TASK_STACK_SIZE=8192
CONFIG_ESP_MAIN_TASK_AFFINITY_CPU1=y
CONFIG_COMPILER_OPTIMIZATION_PERF=y
CONFIG_PARTITION_TABLE_SINGLE_APP=y
```
